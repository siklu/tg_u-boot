## common/siklu/Kconfig
```kconfig
menu "Siklu Commands and functionality"

config SIKLU
	bool "Siklu devices"
	   
config SIKLU_CONFIG_MTD_PART
	string "Siklu device configuration partition"
	default "device_config"

config SIKLU_BANK_MGMT_MTD_PART
	string "Siklu device management partition"
	default "device_mgmt"

config SIKLU_ENV_IS_IN_MTD_NOR
	bool "Adds MTDPARTS-based environment location"

if SIKLU_ENV_IS_IN_MTD_NOR
menu "Siklu Environment Settings"

config SIKLU_ENV_PART
	string "SPI NOR environment MTD partition"

config SIKLU_DEFAULT_MAC_ADDRESS
	string "MAC address the device should use if it failed to get one using device_config"
	default "00:24:a4:00:de:ad"

endmenu
endif

menu "NAND boot Options"

config SIKLU_ROOTFS_VOLUME_NANE
	string "The rootfs's ubi volume name"
	default "rootfs"
	
endmenu

menu "NFS Boot Options"

config SIKLU_DEFAULT_NFS_SERVERIP
	string "Default NFS serverip"
	default "192.168.1.30"
	
config SIKLU_DEFAULT_NFS_NETMASK
	string "Default NFS netmask"
	default "255.255.254.0"
	
config SIKLU_DEFAULT_NFS_ROOTPATH
	string "Default NFS rootpath (%s = developer_id)"
	default "/local/home/%s/n366_nfs"
	
config SIKLU_NFS_NETDEV
	string "The linux network device that will be used to load nfs"
	default "eth1"
	
config SIKLU_NFS_USB_NETDEV
	string "The linux network device that will be used to load nfs, on USB mode"
	default "usb0"
	
config SIKLU_NFS_HOSTNAME
	string "Hostname to be passed to Linux when booting from NFS"
	default "Siklu"
	
config SIKLU_LINUX_NFS_VERSION
	string "Linux NFS version to be used when using nfsroot"
	default "3"

endmenu

endmenu
```

## configs/ipq6018_defconfig
```kconfig
CONFIG_ARM=y
CONFIG_ARCH_IPQ6018=y
CONFIG_USB_XHCI_IPQ=y
CONFIG_PCI_IPQ=y
CONFIG_IPQ6018_QCA_AQUANTIA_PHY=y
CONFIG_QCA8081_PHY=y
CONFIG_QCA8075_PHY=y
CONFIG_FIT=y
CONFIG_FIT_VERBOSE=y
CONFIG_SYS_PROMPT="IPQ6018# "
# CONFIG_CMD_BOOTD is not set
# CONFIG_CMD_RUN is not set
# CONFIG_CMD_IMI is not set
# CONFIG_CMD_IMLS is not set
# CONFIG_CMD_XIMG is not set
CONFIG_CMD_GPIO=y
# CONFIG_CMD_NFS is not set
CONFIG_CMD_PART=y
CONFIG_PARTITION_UUIDS=y
CONFIG_SIKLU=y
CONFIG_SIKLU_ENV_IS_IN_MTD_NOR=y
CONFIG_SIKLU_DEFAULT_NFS_SERVERIP="192.168.42.30"
CONFIG_SIKLU_DEFAULT_NFS_ROOTPATH="/local/home/%s/ipq6010-ctu_nfs"
CONFIG_OF_CONTROL=y
CONFIG_USB=y
CONFIG_DM_USB=y
CONFIG_USE_PRIVATE_LIBGCC=y
CONFIG_LZMA=y
```

## configs/mvebu_8040_n366_defconfig
```kconfig
CONFIG_ARM=y
CONFIG_ARCH_MVEBU=y
CONFIG_FIT=y
CONFIG_FIT_VERBOSE=y
CONFIG_SYS_TEXT_BASE=0x00000000
CONFIG_SYS_MALLOC_F_LEN=0x2000
CONFIG_TARGET_MVEBU_ARMADA_8K=y
CONFIG_ENV_SIZE=0x10000
CONFIG_DM_GPIO=y
CONFIG_DEBUG_UART_BASE=0xf0512000
CONFIG_DEBUG_UART_CLOCK=200000000
CONFIG_DEBUG_UART=y
CONFIG_DISTRO_DEFAULTS=y
CONFIG_SYS_BOOT_GET_CMDLINE=y
# CONFIG_SYS_MALLOC_CLEAR_ON_INIT is not set
CONFIG_OF_STDOUT_VIA_ALIAS=y
CONFIG_SPI_BOOT=y
CONFIG_BOOTDELAY=4
CONFIG_USE_BOOTARGS=y
CONFIG_BOOTCOMMAND="siklu_nand_boot"
CONFIG_LOGLEVEL=8
CONFIG_SYS_CONSOLE_ENV_OVERWRITE=y
CONFIG_SYS_CONSOLE_INFO_QUIET=y
CONFIG_LOG=y
CONFIG_LOG_MAX_LEVEL=8
CONFIG_LOG_ERROR_RETURN=y
# CONFIG_DISPLAY_CPUINFO is not set
CONFIG_ARCH_EARLY_INIT_R=y
CONFIG_SYS_PROMPT="Skl>> "
CONFIG_CMD_BOOTZ=y
CONFIG_CMD_MEMTEST=y
# CONFIG_CMD_FLASH is not set
CONFIG_CMD_GPIO=y
CONFIG_CMD_I2C=y
CONFIG_CMD_PCI=y
CONFIG_CMD_SF_TEST=y
CONFIG_CMD_SPI=y
CONFIG_CMD_USB=y
# CONFIG_CMD_SETEXPR is not set
CONFIG_CMD_CACHE=y
CONFIG_CMD_TIME=y
CONFIG_CMD_MVEBU_BUBT=y
CONFIG_CMD_REGULATOR=y
CONFIG_CMD_MTDPARTS=y
CONFIG_MTDIDS_DEFAULT="nand0=f4720000.nand,nor0=spi0.0"
CONFIG_MTDPARTS_DEFAULT="mtdparts=f4720000.nand:200m(first_bank),200m(second_bank),80m(data),-(log);spi0.0:1792k(uboot),64k(uboot_env),64k(device_config),64k(device_mgmt)"
CONFIG_CMD_UBI=y
CONFIG_SIKLU=y
CONFIG_SIKLU_ENV_IS_IN_MTD_NOR=y
CONFIG_SIKLU_ENV_PART="uboot_env"
CONFIG_MAC_PARTITION=y
CONFIG_DEFAULT_DEVICE_TREE="armada-8040-n366"
# CONFIG_ENV_IS_NOWHERE is not set
CONFIG_REGMAP=y
CONFIG_BLK=y
CONFIG_DM_I2C=y
CONFIG_SYS_I2C_MVTWSI=y
CONFIG_LED=y
CONFIG_LED_GPIO=y
CONFIG_MISC=y
# CONFIG_MMC is not set
CONFIG_MTD=y
CONFIG_MTD_RAW_NAND=y
CONFIG_SYS_NAND_USE_FLASH_BBT=y
CONFIG_NAND_PXA3XX=y
CONFIG_SF_DEFAULT_MODE=0x3
CONFIG_SPI_FLASH_GIGADEVICE=y
CONFIG_SPI_FLASH_MACRONIX=y
CONFIG_SPI_FLASH_MTD=y
CONFIG_MTD_UBI_FASTMAP=y
CONFIG_PHY_MARVELL=y
CONFIG_MVPP2=y
CONFIG_PCI=y
CONFIG_DM_PCI=y
CONFIG_PCIE_DW_MVEBU=y
CONFIG_MVEBU_COMPHY_SUPPORT=y
CONFIG_PINCTRL=y
# CONFIG_PINCTRL_GENERIC is not set
CONFIG_PINCTRL_ARMADA_8K=y
CONFIG_DM_REGULATOR_FIXED=y
CONFIG_DM_RTC=y
# CONFIG_SCSI is not set
CONFIG_DEBUG_UART_SHIFT=2
CONFIG_DEBUG_UART_ANNOUNCE=y
CONFIG_SYS_NS16550=y
CONFIG_KIRKWOOD_SPI=y
CONFIG_DM_THERMAL=y
CONFIG_USB=y
CONFIG_DM_USB=y
CONFIG_USB_XHCI_HCD=y
CONFIG_USB_HOST_ETHER=y
CONFIG_USB_ETHER_RTL8152=y
CONFIG_EXT4_WRITE=y
CONFIG_ERRNO_STR=y
# CONFIG_EFI_LOADER is not set
CONFIG_DISABLE_CONSOLE=y
```
